#include "lcd.h"
#include "dsihost.h"

/* Adapted from BSP/STM32U5x9J-DK/stm32u5x9j_discovery_lcd.c for RGB565
 * continuous frame buffers. LTDC and DSI host configuration remain in CubeMX.
 */
HAL_StatusTypeDef LCD_Init(void) {
  RCC_PeriphCLKInitTypeDef clock = {0};
  uint32_t errors = 0U;
  static const uint8_t InitParam1[3] = {0xFF, 0x83, 0x79};
  static const uint8_t InitParam2[16] = {0x44, 0x1C, 0x1C, 0x37, 0x57, 0x90,
                                         0xD0, 0xE2, 0x58, 0x80, 0x38, 0x38,
                                         0xF8, 0x33, 0x34, 0x42};
  static const uint8_t InitParam3[9] = {0x80, 0x14, 0x0C, 0x30, 0x20,
                                        0x50, 0x11, 0x42, 0x1D};
  static const uint8_t InitParam4[10] = {0x01, 0xAA, 0x01, 0xAF, 0x01,
                                         0xAF, 0x10, 0xEA, 0x1C, 0xEA};
  static const uint8_t InitParam5[4] = {0x00, 0x00, 0x00, 0xC0};
  static const uint8_t InitParam6[37] = {
      0x00, 0x07, 0x00, 0x00, 0x00, 0x08, 0x08, 0x32, 0x10, 0x01,
      0x00, 0x01, 0x03, 0x72, 0x03, 0x72, 0x00, 0x08, 0x00, 0x08,
      0x33, 0x33, 0x05, 0x05, 0x37, 0x05, 0x05, 0x37, 0x0A, 0x00,
      0x00, 0x00, 0x0A, 0x00, 0x01, 0x00, 0x0E};
  static const uint8_t InitParam7[34] = {
      0x18, 0x18, 0x18, 0x18, 0x18, 0x18, 0x18, 0x18, 0x19, 0x19, 0x18, 0x18,
      0x18, 0x18, 0x19, 0x19, 0x01, 0x00, 0x03, 0x02, 0x05, 0x04, 0x07, 0x06,
      0x23, 0x22, 0x21, 0x20, 0x18, 0x18, 0x18, 0x18, 0x00, 0x00};
  /* BSP sends 35 bytes for D6 but declares only 32 bytes; retain its packet
   * length with explicit zero padding instead of reading past the array. */
  static const uint8_t InitParam8[35] = {
      0x18, 0x18, 0x18, 0x18, 0x18, 0x18, 0x18, 0x18, 0x19, 0x19, 0x18,
      0x18, 0x19, 0x19, 0x18, 0x18, 0x06, 0x07, 0x04, 0x05, 0x02, 0x03,
      0x00, 0x01, 0x20, 0x21, 0x22, 0x23, 0x18, 0x18, 0x18, 0x18};
  static const uint8_t InitParam9[42] = {
      0x00, 0x16, 0x1B, 0x30, 0x36, 0x3F, 0x24, 0x40, 0x09, 0x0D, 0x0F,
      0x18, 0x0E, 0x11, 0x12, 0x11, 0x14, 0x07, 0x12, 0x13, 0x18, 0x00,
      0x17, 0x1C, 0x30, 0x36, 0x3F, 0x24, 0x40, 0x09, 0x0C, 0x0F, 0x18,
      0x0E, 0x11, 0x14, 0x11, 0x12, 0x07, 0x12, 0x14, 0x18};
  static const uint8_t InitParam10[3] = {0x2C, 0x2C, 0x00};
  static const uint8_t InitParam11[43] = {
      0x01, 0x00, 0x07, 0x0F, 0x16, 0x1F, 0x27, 0x30, 0x38, 0x40, 0x47,
      0x4E, 0x56, 0x5D, 0x65, 0x6D, 0x74, 0x7D, 0x84, 0x8A, 0x90, 0x99,
      0xA1, 0xA9, 0xB0, 0xB6, 0xBD, 0xC4, 0xCD, 0xD4, 0xDD, 0xE5, 0xEC,
      0xF3, 0x36, 0x07, 0x1C, 0xC0, 0x1B, 0x01, 0xF1, 0x34, 0x00};
  static const uint8_t InitParam12[43] = {
      0x00, 0x08, 0x0F, 0x16, 0x1F, 0x28, 0x31, 0x39, 0x41, 0x48, 0x51,
      0x59, 0x60, 0x68, 0x70, 0x78, 0x7F, 0x87, 0x8D, 0x94, 0x9C, 0xA3,
      0xAB, 0xB3, 0xB9, 0xC1, 0xC8, 0xD0, 0xD8, 0xE0, 0xE8, 0xEE, 0xF5,
      0x3B, 0x1A, 0xB6, 0xA0, 0x07, 0x45, 0xC5, 0x37, 0x00};
  static const uint8_t InitParam13[42] = {
      0x00, 0x09, 0x0F, 0x18, 0x21, 0x2A, 0x34, 0x3C, 0x45, 0x4C, 0x56,
      0x5E, 0x66, 0x6E, 0x76, 0x7E, 0x87, 0x8E, 0x95, 0x9D, 0xA6, 0xAF,
      0xB7, 0xBD, 0xC5, 0xCE, 0xD5, 0xDF, 0xE7, 0xEE, 0xF4, 0xFA, 0xFF,
      0x0C, 0x31, 0x83, 0x3C, 0x5B, 0x56, 0x1E, 0x5A, 0xFF};

  clock.PeriphClockSelection = RCC_PERIPHCLK_DSI;
  clock.DsiClockSelection = RCC_DSICLKSOURCE_DSIPHY;
  if (HAL_RCCEx_PeriphCLKConfig(&clock) != HAL_OK)
    return HAL_ERROR;

  HAL_Delay(11);
  HAL_GPIO_WritePin(GPIOD, GPIO_PIN_5, GPIO_PIN_SET);
  HAL_Delay(150);
  if (HAL_DSI_Start(&hdsi) != HAL_OK)
    return HAL_ERROR;

  errors +=
      HAL_DSI_LongWrite(&hdsi, 0, DSI_DCS_LONG_PKT_WRITE, sizeof(InitParam1),
                        0xB9, (uint8_t *)InitParam1) != HAL_OK;
  errors +=
      HAL_DSI_LongWrite(&hdsi, 0, DSI_DCS_LONG_PKT_WRITE, sizeof(InitParam2),
                        0xB1, (uint8_t *)InitParam2) != HAL_OK;
  errors +=
      HAL_DSI_LongWrite(&hdsi, 0, DSI_DCS_LONG_PKT_WRITE, sizeof(InitParam3),
                        0xB2, (uint8_t *)InitParam3) != HAL_OK;
  errors +=
      HAL_DSI_LongWrite(&hdsi, 0, DSI_DCS_LONG_PKT_WRITE, sizeof(InitParam4),
                        0xB4, (uint8_t *)InitParam4) != HAL_OK;
  errors +=
      HAL_DSI_LongWrite(&hdsi, 0, DSI_DCS_LONG_PKT_WRITE, sizeof(InitParam5),
                        0xC7, (uint8_t *)InitParam5) != HAL_OK;
  errors += HAL_DSI_ShortWrite(&hdsi, 0, DSI_DCS_SHORT_PKT_WRITE_P1, 0xCC,
                               0x02) != HAL_OK;
  errors += HAL_DSI_ShortWrite(&hdsi, 0, DSI_DCS_SHORT_PKT_WRITE_P1, 0xD2,
                               0x77) != HAL_OK;
  errors +=
      HAL_DSI_LongWrite(&hdsi, 0, DSI_DCS_LONG_PKT_WRITE, sizeof(InitParam6),
                        0xD3, (uint8_t *)InitParam6) != HAL_OK;
  errors +=
      HAL_DSI_LongWrite(&hdsi, 0, DSI_DCS_LONG_PKT_WRITE, sizeof(InitParam7),
                        0xD5, (uint8_t *)InitParam7) != HAL_OK;
  errors +=
      HAL_DSI_LongWrite(&hdsi, 0, DSI_DCS_LONG_PKT_WRITE, sizeof(InitParam8),
                        0xD6, (uint8_t *)InitParam8) != HAL_OK;
  errors +=
      HAL_DSI_LongWrite(&hdsi, 0, DSI_DCS_LONG_PKT_WRITE, sizeof(InitParam9),
                        0xE0, (uint8_t *)InitParam9) != HAL_OK;
  errors +=
      HAL_DSI_LongWrite(&hdsi, 0, DSI_DCS_LONG_PKT_WRITE, sizeof(InitParam10),
                        0xB6, (uint8_t *)InitParam10) != HAL_OK;
  errors += HAL_DSI_ShortWrite(&hdsi, 0, DSI_DCS_SHORT_PKT_WRITE_P1, 0xBD,
                               0x00) != HAL_OK;
  errors += HAL_DSI_LongWrite(&hdsi, 0, DSI_DCS_LONG_PKT_WRITE, 42U, 0xC1,
                              (uint8_t *)InitParam11) != HAL_OK;
  errors += HAL_DSI_ShortWrite(&hdsi, 0, DSI_DCS_SHORT_PKT_WRITE_P1, 0xBD,
                               0x01) != HAL_OK;
  errors += HAL_DSI_LongWrite(&hdsi, 0, DSI_DCS_LONG_PKT_WRITE, 42U, 0xC1,
                              (uint8_t *)InitParam12) != HAL_OK;
  errors += HAL_DSI_ShortWrite(&hdsi, 0, DSI_DCS_SHORT_PKT_WRITE_P1, 0xBD,
                               0x02) != HAL_OK;
  errors +=
      HAL_DSI_LongWrite(&hdsi, 0, DSI_DCS_LONG_PKT_WRITE, sizeof(InitParam13),
                        0xC1, (uint8_t *)InitParam13) != HAL_OK;
  errors += HAL_DSI_ShortWrite(&hdsi, 0, DSI_DCS_SHORT_PKT_WRITE_P1, 0xBD,
                               0x00) != HAL_OK;
  errors += HAL_DSI_ShortWrite(&hdsi, 0, DSI_DCS_SHORT_PKT_WRITE_P0,
                               DSI_EXIT_SLEEP_MODE, 0x00) != HAL_OK;
  if (errors != 0U)
    return HAL_ERROR;

  HAL_Delay(120);
  if (HAL_DSI_ShortWrite(&hdsi, 0, DSI_DCS_SHORT_PKT_WRITE_P0,
                         DSI_SET_DISPLAY_ON, 0x00) != HAL_OK)
    return HAL_ERROR;
  HAL_Delay(120);
  return HAL_OK;
}
